## buildroot-external/Config.in
```kconfig
# Buildroot configuration for LUKS encryption
#
# This configuration is available in menuconfig under "External options"
#

menu "LUKS Disk Encryption"

config BR2_LUKS_ENCRYPT
	bool "Enable LUKS rootfs encryption"
	help
	  Enable automatic LUKS encryption of the rootfs partition
	  during the post-image phase.
	  
	  When enabled, the SD card image will be encrypted with a
	  unique keyfile that can be used with a USB key for automatic
	  unlock at boot.
	  
	  Requires: cryptsetup, parted, rsync on the build host.

if BR2_LUKS_ENCRYPT

config BR2_LUKS_CRYPTO
	string "Encryption algorithm"
	default "aes"
	help
	  Encryption algorithm to use:
	  - "aes" (default): AES-XTS-PLAIN64, fast on Pi5 with AES-NI
	  - "xchacha": XChaCha20-Adiantum, faster on Pi4 and earlier
	  
	  For Raspberry Pi 5, use "aes" for best performance.
	  For Raspberry Pi 4 and earlier, use "xchacha".

config BR2_LUKS_KEYDIR
	string "Keyfile storage directory"
	default "$(BINARIES_DIR)/keys"
	help
	  Directory where generated keyfiles will be stored.
	  
	  Default: $(BINARIES_DIR)/keys (output/images/keys)
	  
	  IMPORTANT: Back up this directory securely!
	  Losing the keyfile means losing access to encrypted data.

config BR2_LUKS_KEYFILE
	string "Use existing keyfile (optional)"
	default ""
	help
	  Path to an existing keyfile to use instead of generating
	  a new one. Leave empty to auto-generate a unique keyfile.
	  
	  The keyfile should be 256 bytes of random data.
	  Compatible with sdm-make-luks-usb-key generated files (.lek).

config BR2_LUKS_KEEP_UNENCRYPTED
	bool "Keep original unencrypted image"
	default n
	help
	  Keep a copy of the original unencrypted image alongside
	  the encrypted one.
	  
	  Useful for debugging, but doubles disk space usage.

config BR2_LUKS_MAPPER_NAME
	string "Device mapper name"
	default "cryptroot"
	help
	  Name for the encrypted device mapper.
	  
	  The decrypted rootfs will be available at:
	  /dev/mapper/<mapper_name>

endif # BR2_LUKS_ENCRYPT

endmenu

# Add your custom package sources here
# source "$BR2_EXTERNAL_LUKS_PI_PATH/package/your-package/Config.in"
```

## configs/raspberrypi5_custom_luks_defconfig
```kconfig
# Raspberry Pi 5 Custom LUKS Configuration
# With secret board overlay support
#
# Usage:
#   make BR2_EXTERNAL=/path/to/buildroot-external raspberrypi5_custom_luks_defconfig
#   make

# Target Architecture - Raspberry Pi 5 (ARM64 Cortex-A76)
BR2_aarch64=y
BR2_cortex_a76=y
BR2_ARM_FPU_VFPV4D16=y

# Toolchain
BR2_TOOLCHAIN_BUILDROOT_GLIBC=y
BR2_TOOLCHAIN_BUILDROOT_CXX=y

# Kernel Headers - Use headers from the kernel being built
BR2_KERNEL_HEADERS_AS_KERNEL=y
# Set minimum kernel headers version to satisfy check-kernel-headers.sh
# The script uses outdated version comparison logic, so we need to set all versions
BR2_TOOLCHAIN_HEADERS_AT_LEAST_3_0=y
BR2_TOOLCHAIN_HEADERS_AT_LEAST_3_1=y
BR2_TOOLCHAIN_HEADERS_AT_LEAST_3_2=y
BR2_TOOLCHAIN_HEADERS_AT_LEAST_3_3=y
BR2_TOOLCHAIN_HEADERS_AT_LEAST_3_4=y
BR2_TOOLCHAIN_HEADERS_AT_LEAST_3_5=y
BR2_TOOLCHAIN_HEADERS_AT_LEAST_3_6=y
BR2_TOOLCHAIN_HEADERS_AT_LEAST_3_7=y
BR2_TOOLCHAIN_HEADERS_AT_LEAST_3_8=y
BR2_TOOLCHAIN_HEADERS_AT_LEAST_3_9=y
BR2_TOOLCHAIN_HEADERS_AT_LEAST_3_10=y
BR2_TOOLCHAIN_HEADERS_AT_LEAST_3_11=y
BR2_TOOLCHAIN_HEADERS_AT_LEAST_3_12=y
BR2_TOOLCHAIN_HEADERS_AT_LEAST_3_13=y
BR2_TOOLCHAIN_HEADERS_AT_LEAST_3_14=y
BR2_TOOLCHAIN_HEADERS_AT_LEAST_3_15=y
BR2_TOOLCHAIN_HEADERS_AT_LEAST_3_16=y
BR2_TOOLCHAIN_HEADERS_AT_LEAST_3_17=y
BR2_TOOLCHAIN_HEADERS_AT_LEAST_3_18=y
BR2_TOOLCHAIN_HEADERS_AT_LEAST_3_19=y
BR2_TOOLCHAIN_HEADERS_AT_LEAST_4_0=y
BR2_TOOLCHAIN_HEADERS_AT_LEAST_4_1=y
BR2_TOOLCHAIN_HEADERS_AT_LEAST_4_2=y
BR2_TOOLCHAIN_HEADERS_AT_LEAST_4_3=y
BR2_TOOLCHAIN_HEADERS_AT_LEAST_4_4=y
BR2_TOOLCHAIN_HEADERS_AT_LEAST_4_5=y
BR2_TOOLCHAIN_HEADERS_AT_LEAST_4_6=y
BR2_TOOLCHAIN_HEADERS_AT_LEAST_4_7=y
BR2_TOOLCHAIN_HEADERS_AT_LEAST_4_8=y
BR2_TOOLCHAIN_HEADERS_AT_LEAST_4_9=y
BR2_TOOLCHAIN_HEADERS_AT_LEAST_4_10=y
BR2_TOOLCHAIN_HEADERS_AT_LEAST_4_11=y
BR2_TOOLCHAIN_HEADERS_AT_LEAST_4_12=y
BR2_TOOLCHAIN_HEADERS_AT_LEAST_4_13=y
BR2_TOOLCHAIN_HEADERS_AT_LEAST_4_14=y
BR2_TOOLCHAIN_HEADERS_AT_LEAST_4_15=y
BR2_TOOLCHAIN_HEADERS_AT_LEAST_4_16=y
BR2_TOOLCHAIN_HEADERS_AT_LEAST_4_17=y
BR2_TOOLCHAIN_HEADERS_AT_LEAST_4_18=y
BR2_TOOLCHAIN_HEADERS_AT_LEAST_4_19=y
BR2_TOOLCHAIN_HEADERS_AT_LEAST_4_20=y
BR2_TOOLCHAIN_HEADERS_AT_LEAST_5_0=y
BR2_TOOLCHAIN_HEADERS_AT_LEAST_5_1=y
BR2_TOOLCHAIN_HEADERS_AT_LEAST_5_2=y
BR2_TOOLCHAIN_HEADERS_AT_LEAST_5_3=y
BR2_TOOLCHAIN_HEADERS_AT_LEAST_5_4=y
BR2_TOOLCHAIN_HEADERS_AT_LEAST_5_5=y
BR2_TOOLCHAIN_HEADERS_AT_LEAST_5_6=y
BR2_TOOLCHAIN_HEADERS_AT_LEAST_5_7=y
BR2_TOOLCHAIN_HEADERS_AT_LEAST_5_8=y
BR2_TOOLCHAIN_HEADERS_AT_LEAST_5_9=y
BR2_TOOLCHAIN_HEADERS_AT_LEAST_5_10=y
BR2_TOOLCHAIN_HEADERS_AT_LEAST_5_11=y
BR2_TOOLCHAIN_HEADERS_AT_LEAST_5_12=y
BR2_TOOLCHAIN_HEADERS_AT_LEAST_5_13=y
BR2_TOOLCHAIN_HEADERS_AT_LEAST_5_14=y
BR2_TOOLCHAIN_HEADERS_AT_LEAST_5_15=y
BR2_TOOLCHAIN_HEADERS_AT_LEAST_5_16=y
BR2_TOOLCHAIN_HEADERS_AT_LEAST_5_17=y
BR2_TOOLCHAIN_HEADERS_AT_LEAST_5_18=y
BR2_TOOLCHAIN_HEADERS_AT_LEAST_5_19=y
BR2_TOOLCHAIN_HEADERS_AT_LEAST_6_0=y
BR2_TOOLCHAIN_HEADERS_AT_LEAST_6_1=y
BR2_TOOLCHAIN_HEADERS_AT_LEAST_6_2=y
BR2_TOOLCHAIN_HEADERS_AT_LEAST_6_3=y
BR2_TOOLCHAIN_HEADERS_AT_LEAST_6_4=y
BR2_TOOLCHAIN_HEADERS_AT_LEAST_6_5=y
BR2_TOOLCHAIN_HEADERS_AT_LEAST_6_6=y
BR2_TOOLCHAIN_HEADERS_AT_LEAST_6_7=y
BR2_TOOLCHAIN_HEADERS_AT_LEAST_6_8=y
BR2_TOOLCHAIN_HEADERS_AT_LEAST_6_9=y
BR2_TOOLCHAIN_HEADERS_AT_LEAST_6_10=y
BR2_TOOLCHAIN_HEADERS_AT_LEAST_6_11=y
BR2_TOOLCHAIN_HEADERS_AT_LEAST_6_12=y
BR2_TOOLCHAIN_HEADERS_AT_LEAST="6.12"
BR2_PACKAGE_HOST_LINUX_HEADERS_CUSTOM_6_12=y
BR2_PACKAGE_LINUX_HEADERS=y

# System Configuration
BR2_TARGET_GENERIC_HOSTNAME="rpi5-custom"
BR2_TARGET_GENERIC_ISSUE="Raspberry Pi 5 - Encrypted"
BR2_SYSTEM_DHCP="eth0"
BR2_INIT_OPENRC=y
BR2_ROOTFS_DEVICE_CREATION_DYNAMIC_EUDEV=y

# Device table with custom permissions (from secret overlay)
BR2_ROOTFS_DEVICE_TABLE="system/device_table.txt $(BR2_EXTERNAL_LUKS_PI5_PATH)/board/raspberrypi5/file_permissions.txt"

# Rootfs overlay (from secret)
BR2_ROOTFS_OVERLAY="$(BR2_EXTERNAL_LUKS_PI5_PATH)/board/raspberrypi5/rootfs-overlay"

# Build scripts
BR2_ROOTFS_POST_BUILD_SCRIPT="$(BR2_EXTERNAL_LUKS_PI5_PATH)/board/raspberrypi5/post-build.sh"
BR2_ROOTFS_POST_IMAGE_SCRIPT="$(BR2_EXTERNAL_LUKS_PI5_PATH)/board/raspberrypi5/post-image.sh $(BR2_EXTERNAL_LUKS_PI5_PATH)/scripts/post-image-encrypt.sh"

# Kernel - Raspberry Pi 5 (rpi-6.12.y)
BR2_LINUX_KERNEL=y
BR2_LINUX_KERNEL_CUSTOM_TARBALL=y
BR2_LINUX_KERNEL_CUSTOM_TARBALL_LOCATION="$(call github,raspberrypi,linux,rpi-6.12.y)/linux-rpi-6.12.y.tar.gz"
BR2_LINUX_KERNEL_DEFCONFIG="bcm2712"
BR2_LINUX_KERNEL_DTS_SUPPORT=y
BR2_LINUX_KERNEL_INTREE_DTS_NAME="broadcom/bcm2712-rpi-5-b"
BR2_LINUX_KERNEL_DTB_OVERLAY_SUPPORT=y
BR2_LINUX_KERNEL_NEEDS_HOST_OPENSSL=y
BR2_LINUX_KERNEL_CONFIG_FRAGMENT_FILES="$(BR2_EXTERNAL_LUKS_PI5_PATH)/board/raspberrypi5/linux-luks.fragment"

# Raspberry Pi Firmware
BR2_PACKAGE_RPI_FIRMWARE=y
BR2_PACKAGE_RPI_FIRMWARE_VARIANT_PI5=y
BR2_PACKAGE_RPI_FIRMWARE_INSTALL_DTB_OVERLAYS=y

# Host tools for image generation
BR2_PACKAGE_HOST_GENIMAGE=y
BR2_PACKAGE_HOST_DOSFSTOOLS=y
BR2_PACKAGE_HOST_MTOOLS=y

# Filesystem
BR2_TARGET_ROOTFS_EXT2=y
BR2_TARGET_ROOTFS_EXT2_4=y
BR2_TARGET_ROOTFS_EXT2_SIZE="512M"
BR2_TARGET_ROOTFS_EXT2_LABEL="rootfs"
BR2_TARGET_ROOTFS_EXT2_MKFS_OPTIONS="-O ^64bit"

# LUKS Encryption packages
BR2_PACKAGE_CRYPTSETUP=y
BR2_PACKAGE_LVM2=y
BR2_PACKAGE_LVM2_DMSETUP=y
BR2_PACKAGE_UTIL_LINUX=y
BR2_PACKAGE_UTIL_LINUX_LIBBLKID=y
BR2_PACKAGE_UTIL_LINUX_LIBUUID=y
BR2_PACKAGE_JSON_C=y

# Networking
BR2_PACKAGE_NETWORKMANAGER=y
BR2_PACKAGE_CHRONY=y
BR2_PACKAGE_DROPBEAR=y
BR2_PACKAGE_DHCPCD=y
BR2_PACKAGE_WIRELESS_TOOLS=y
BR2_PACKAGE_WPA_SUPPLICANT=y
BR2_PACKAGE_IW=y
BR2_PACKAGE_LINUX_FIRMWARE=y
BR2_PACKAGE_LINUX_FIRMWARE_BRCM_BCM43XXX=y

# Core utilities
BR2_PACKAGE_BUSYBOX_SHOW_OTHERS=y
BR2_PACKAGE_BASH=y
BR2_PACKAGE_COREUTILS=y
BR2_PACKAGE_PROCPS_NG=y
BR2_PACKAGE_HTOP=y

# Filesystem utilities
BR2_PACKAGE_E2FSPROGS=y
BR2_PACKAGE_DOSFSTOOLS=y

# Python (for custom scripts)
BR2_PACKAGE_PYTHON3=y
BR2_PACKAGE_PYTHON3_PY_PYC=y

# LUKS Encryption Settings (External options menu)
BR2_LUKS_ENCRYPT=y
BR2_LUKS_CRYPTO="aes"
# BR2_LUKS_KEEP_UNENCRYPTED is not set
```
